## arch/arm/mach-zx/Kconfig
```kconfig
if ARCH_ZX

config SYS_SOC
	default "zx297520v3"

config SYS_VENDOR
	default "zx"

choice
	prompt "Sanechip board select"

config TARGET_ZX297520V3
	bool "Sanechip ZX297520V3 SoC"
	select CPU_V7A
	help
	  Support for Sanechip ZX297520V3 SoC (Cortex-A53 running in 32-bit AArch32 mode).

endchoice

config SYS_BOARD
	string "Board name"
	default "zx297520v3" if TARGET_ZX297520V3
	default ""
	help
	  This option contains information about board name.
	  Based on this option board/<CONFIG_SYS_VENDOR>/<CONFIG_SYS_BOARD> will
	  be used.

config SYS_CONFIG_NAME
	default "zx297520v3" if TARGET_ZX297520V3

endif
```

## configs/zx297520v3_defconfig
```kconfig
CONFIG_ARM=y
CONFIG_ARCH_CPU_INIT=y
CONFIG_ARCH_ZX=y
CONFIG_SUPPORT_PASSING_ATAGS=y
CONFIG_SETUP_MEMORY_TAGS=y
CONFIG_CMDLINE_TAG=y
CONFIG_INITRD_TAG=y
CONFIG_STATIC_MACH_TYPE=y
CONFIG_MACH_TYPE=7523
CONFIG_CC_OPTIMIZE_FOR_SIZE=y
# CONFIG_SYS_LONGHELP is not set
# CONFIG_AUTO_COMPLETE is not set
# CONFIG_CMDLINE_EDITING is not set
# CONFIG_LOG is not set
CONFIG_NET=y
CONFIG_NETDEVICES=y
CONFIG_DM_ETH=y
CONFIG_ZX29_GMAC=y
CONFIG_FAILSAFE=y
CONFIG_MTK_TCP=y
CONFIG_MTK_HTTPD=y
CONFIG_MD5=y
# CONFIG_CMD_PXE is not set
# CONFIG_CMD_SYSBOOT is not set
# CONFIG_CMD_LOADB is not set
# CONFIG_CMD_LOADS is not set
# CONFIG_CMD_FDT is not set
# CONFIG_MMC is not set
# CONFIG_GENERIC_MMC is not set
# CONFIG_ZLIB is not set
# CONFIG_GZIP is not set
CONFIG_TEXT_BASE=0x21DF0000
CONFIG_NR_DRAM_BANKS=1
CONFIG_DEFAULT_DEVICE_TREE="mf920u"
CONFIG_SYS_LOAD_ADDR=0x25000000
CONFIG_DEBUG_UART_BASE=0x1408000
CONFIG_DEBUG_UART_CLOCK=24000000
CONFIG_DEBUG_UART=y
CONFIG_OPTIMIZE_INLINING=y
# CONFIG_EFI_LOADER is not set
# CONFIG_ANDROID_BOOT_IMAGE is not set
CONFIG_BOOTDELAY=1
# CONFIG_SYS_DEVICE_NULLDEV is not set
# CONFIG_CYCLIC is not set
CONFIG_BOARD_EARLY_INIT_F=y
CONFIG_BOARD_LATE_INIT=y
# CONFIG_HUSH_PARSER is not set
# CONFIG_CMD_BDINFO_EXTRA is not set
# CONFIG_CMD_UFETCH is not set
CONFIG_CMD_BOOTZ=y
# CONFIG_BOOTM_PLAN9 is not set
# CONFIG_BOOTM_RTEMS is not set
# CONFIG_BOOTM_VXWORKS is not set
# CONFIG_CMD_MEMINFO is not set
# CONFIG_CMD_MEMINFO_MAP is not set
# CONFIG_CMD_BIND is not set
# CONFIG_CMD_CLK is not set
# CONFIG_CMD_DM is not set
# CONFIG_CMD_TIME is not set
# CONFIG_CMD_HASH is not set
CONFIG_OF_EMBED=y
# CONFIG_DM_DEBUG is not set
CONFIG_CLK=y
CONFIG_CLK_STUB=y
CONFIG_SPECIFY_CONSOLE_INDEX=y
CONFIG_DM_SERIAL=y
CONFIG_DEBUG_UART_PL011=y
CONFIG_DEBUG_UART_ANNOUNCE=y
CONFIG_DEBUG_UART_SKIP_INIT=y
CONFIG_PL01X_SERIAL=y
CONFIG_ZX29_PL011_SERIAL=y
CONFIG_TIMER=y
CONFIG_ZX29_TIMER=y
CONFIG_USB=y
CONFIG_DM_USB_GADGET=y
CONFIG_USB_GADGET=y
CONFIG_USB_GADGET_MANUFACTURER="Wifi Chan"
CONFIG_USB_GADGET_VENDOR_NUM=0x0d00
CONFIG_USB_GADGET_PRODUCT_NUM=0x0721
CONFIG_USB_GADGET_DWC2_OTG=y
CONFIG_USB_ETHER=y
CONFIG_USB_ETH_RNDIS=y
CONFIG_USBNET_DEV_ADDR="de:ad:be:ef:00:01"
CONFIG_USBNET_HOST_ADDR="de:ad:be:ef:00:00"
CONFIG_LZMA=y
CONFIG_LZMA_SIZE_OPTIMIZATION=y
# CONFIG_PXE_UTILS is not set
# CONFIG_EFI_LOADER is not set
# CONFIG_CMD_BOOTEFI is not set
# CONFIG_CMD_EFICONFIG is not set
# CONFIG_SMBIOS is not set
```

## failsafe/Kconfig
```kconfig
# SPDX-License-Identifier: GPL-2.0

menuconfig FAILSAFE
	bool "ZX297520V3 Web Failsafe Recovery"
	select MTK_TCP
	select MTK_HTTPD
	select MD5
	default y
	help
	  Enable the Web-based recovery UI on port 80 to flash firmware, MTD partitions,
	  bootloaders and full flash images for Sanechip ZX297520V3.
```
